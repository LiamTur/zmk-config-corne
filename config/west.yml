## config/west.yml
```yaml
manifest:
  remotes:
    - name: zmkfirmware
      url-base: https://github.com/zmkfirmware
    - name: nicekeyboards
      url-base: https://github.com/nicekeyboards
    - name: joelspadin
      url-base: https://github.com/joelspadin
  projects:
    - name: zmk
      remote: zmkfirmware
      revision: main
      import: app/west.yml
    - name: zmk-nice-nano
      remote: nicekeyboards
      revision: main
      path: modules/nicekeyboards/zmk-nice-nano
    - name: zmk-locales
      remote: joelspadin
      revision: main
      path: modules/joelspadin/zmk-locales
  self:
    path: config
```
